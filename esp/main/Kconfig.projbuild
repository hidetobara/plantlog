## esp/main/Kconfig.projbuild
```kconfig
menu "ESP32 Camera Demo Configuration"

config WIFI_SSID
    string "aterm-723858-g"
    default "aterm-723858-g"
    help
        SSID (network name) for the demo to connect to.

config WIFI_PASSWORD
    string "kogaidan"
    default "kogaidan"
    help
        Password for your network.
        
config XCLK_FREQ
    int "XCLK Frequency"
    default "20000000"
    help
        The XCLK Frequency in Herz.
        
menu "Pin Configuration"
    config D0
        int "D0"
        default "17"
    config D1
        int "D1"
        default "35"
    config D2
        int "D2"
        default "34"
    config D3
        int "D3"
        default "5"
    config D4
        int "D4"
        default "39"
    config D5
        int "D5"
        default "18"
    config D6
        int "D6"
        default "36"
    config D7
        int "D7"
        default "19"
    config XCLK
        int "XCLK"
        default "27"
    config PCLK
        int "PCLK"
        default "21"
    config VSYNC
        int "VSYNC"
        default "22"
    config HREF
        int "HREF"
        default "26"
    config SDA
        int "SDA"
        default "25"
    config SCL
        int "SCL"
        default "23"
    config RESET
        int "RESET"
        default "15"
endmenu

endmenu
```
